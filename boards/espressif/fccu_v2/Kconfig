## boards/espressif/fccu_v2/Kconfig.fccu_v2
```kconfig
config BOARD_FCCU_V2
	select SOC_ESP32S3_WROOM_N8
	select SOC_ESP32S3_PROCPU if BOARD_FCCU_V2_ESP32S3_PROCPU
```

## boards/espressif/fccu_v2/board.yml
```yaml
board:
  name: fccu_v2
  full_name: Hydrogreen-FCCU-V2
  vendor: hydrogreen
  socs:
    - name: esp32s3
```
